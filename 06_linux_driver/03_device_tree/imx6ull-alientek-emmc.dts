/*
 * Copyright (C) 2016 Freescale Semiconductor, Inc.
 *
 * This program is free software; you can redistribute it and/or modify
 * it under the terms of the GNU General Public License version 2 as
 * published by the Free Software Foundation.
 */

/dts-v1/;

#include <dt-bindings/input/input.h>
#include "imx6ull.dtsi"

/ {
	model = "Freescale i.MX6 ULL 14x14 EVK Board";
	compatible = "fsl,imx6ull-14x14-evk", "fsl,imx6ull";

	my_demo_node {
		compatible = "alientek,my-demo-device";
		reg = <0x88888888 4>;
		my-property-str = "Hello Device Tree!";
		my-property-num = <2026>;
		status = "okay";
	};

	chosen {
		stdout-path = &uart1;
	};

    // ...
};

// ...
